#include <behaviors.dtsi>
#include <dt-bindings/zmk/mouse.h>

/ {
    keymap {
        compatible = "zmk,keymap";
        default_layer {
            bindings = <
              &mkp LCLK
            >;
        };
    };
};